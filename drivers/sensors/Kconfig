## drivers/sensors/Kconfig
```kconfig
menuconfig SENSORS
	bool "Sensors Support"
	help
	  Say Y to enable Sensors support.  This allows control of supported
	  Sensors.

if SENSORS

source "drivers/sensors/proxlight/Kconfig"
source "drivers/sensors/compass/Kconfig"
source "drivers/sensors/mpu3050_v333/Kconfig"

endif # SENSORS
```

## drivers/sensors/compass/Kconfig
```kconfig
#
# MAGNETIC Sensor Configuration
#
config COMPASS
	bool "MAGNETIC Sensor"
	default n
	help
	  This option enables magnetic sensors

config SENSORS_AK8975
	tristate "AK8975 magnetometer support"
	default n
	depends on COMPASS
	help
	  If you say yes here you get support for Asahi Kasei's
	  magnetometer sensor AK8975C.
```

## drivers/sensors/proxlight/Kconfig
```kconfig
#
# PROXIMITY & LIGHT Sensor Configuration
#
config PROXLIGHT
	bool "PROXIMITY & LIGHT Sensor"
	default n
	help
	  This option enables proximity sensors

config SENSORS_BH1721FVC_P3
	tristate "ROHM BH1721FVC ambient light sensor"
	default n
	depends on PROXLIGHT
	help
	  Say Y here if you have ROHM BH1721FVC hooked to an I2C bus.
	  This option eanbles the light sensor device driver for
	  the ROHM BH1721FVC chip.

config SENSORS_BH1721FVC
	tristate "ROHM BH1721FVC ambient light sensor"
	default n
	depends on PROXLIGHT
	help
	  Say Y here if you have ROHM BH1721FVC hooked to an I2C bus.
	  This option eanbles the light sensor device driver for
	  the ROHM BH1721FVC chip.

config SENSORS_AL3201
	tristate "LITEON AL3201 ambient light sensor"
	depends on PROXLIGHT
	help
	  Say Y here if you have LITEON AL3201 hooked to an I2C bus.

	  This option eanbles the light sensor device driver for
	  the LITEON AL3201 chip.
```
